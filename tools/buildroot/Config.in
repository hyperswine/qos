## tools/buildroot/Config.in
```kconfig
source "$BR2_EXTERNAL_QOSP_PATH/package/qosp/Config.in"
source "$BR2_EXTERNAL_QOSP_PATH/package/qosp-star64-spltool/Config.in.host"
source "$BR2_EXTERNAL_QOSP_PATH/package/qosp-star64-tools/Config.in"
```

## tools/buildroot/configs/qosp_qemu_aarch64_defconfig
```kconfig
BR2_aarch64=y
BR2_TOOLCHAIN_BUILDROOT_LIBC="glibc"
BR2_TOOLCHAIN_BUILDROOT_CXX=y
BR2_PACKAGE_HOST_LINUX_HEADERS_CUSTOM_6_12=y
BR2_GLOBAL_PATCH_DIR="board/qemu/patches"
# mdev, so this target exercises the same init and module-loading path the
# Pi does -- that is the whole reason for having it
BR2_ROOTFS_DEVICE_CREATION_DYNAMIC_MDEV=y
BR2_SYSTEM_DHCP="eth0"
BR2_TARGET_GENERIC_HOSTNAME="qosp"
BR2_TARGET_GENERIC_ISSUE="QOS Portable"
BR2_LINUX_KERNEL=y
BR2_LINUX_KERNEL_CUSTOM_VERSION=y
BR2_LINUX_KERNEL_CUSTOM_VERSION_VALUE="6.12.27"
BR2_LINUX_KERNEL_USE_CUSTOM_CONFIG=y
BR2_LINUX_KERNEL_CUSTOM_CONFIG_FILE="board/qemu/aarch64-virt/linux.config"
BR2_LINUX_KERNEL_CONFIG_FRAGMENT_FILES="$(BR2_EXTERNAL_QOSP_PATH)/board/qosp/linux-gfx-input.fragment"
BR2_LINUX_KERNEL_NEEDS_HOST_OPENSSL=y
BR2_PACKAGE_MESA3D=y
BR2_PACKAGE_MESA3D_GALLIUM_DRIVER_SWRAST=y
BR2_PACKAGE_MESA3D_OPENGL_EGL=y
BR2_PACKAGE_MESA3D_OPENGL_ES=y
BR2_PACKAGE_OPENSSH=y
BR2_PACKAGE_IW=y
BR2_PACKAGE_WPA_SUPPLICANT=y
BR2_PACKAGE_WPA_SUPPLICANT_CLI=y
BR2_PACKAGE_WPA_SUPPLICANT_PASSPHRASE=y
BR2_TARGET_ROOTFS_EXT2=y
BR2_TARGET_ROOTFS_EXT2_4=y
BR2_TARGET_ROOTFS_EXT2_SIZE="512M"
# BR2_TARGET_ROOTFS_TAR is not set
BR2_PACKAGE_QOSP=y
```

## tools/buildroot/configs/qosp_star64_defconfig
```kconfig
# Linux bring-up baseline; optionally enable QOSP with an RV64 Main profile.
# Buildroot 2026.08; board kernel/bootloader from its 2025.02 STAR64 target.
BR2_riscv=y
BR2_RISCV_ISA_RVC=y
BR2_TOOLCHAIN_BUILDROOT_LIBC="glibc"
BR2_TOOLCHAIN_BUILDROOT_CXX=y
BR2_GCC_VERSION_14_X=y
BR2_PACKAGE_HOST_LINUX_HEADERS_CUSTOM_5_15=y
BR2_GLOBAL_PATCH_DIR="$(BR2_EXTERNAL_QOSP_PATH)/board/qosp/star64/patches"
BR2_DOWNLOAD_FORCE_CHECK_HASHES=y
BR2_ROOTFS_DEVICE_CREATION_DYNAMIC_MDEV=y
BR2_TARGET_GENERIC_HOSTNAME="qos-star64"
BR2_TARGET_GENERIC_ISSUE="STAR64 Linux bring-up"
BR2_TARGET_GENERIC_GETTY_PORT="ttyS0"
BR2_ROOTFS_OVERLAY="$(BR2_EXTERNAL_QOSP_PATH)/board/qosp/star64/overlay"
BR2_ROOTFS_POST_BUILD_SCRIPT="$(BR2_EXTERNAL_QOSP_PATH)/board/qosp/star64/post-build.sh"
BR2_ROOTFS_POST_IMAGE_SCRIPT="support/scripts/genimage.sh"
BR2_ROOTFS_POST_SCRIPT_ARGS="-c $(BR2_EXTERNAL_QOSP_PATH)/board/qosp/star64/genimage.cfg"
BR2_LINUX_KERNEL=y
BR2_LINUX_KERNEL_CUSTOM_TARBALL=y
BR2_LINUX_KERNEL_CUSTOM_TARBALL_LOCATION="$(call github,Fishwaldo,Star64_linux,1456c984f15e21e28fb8a9ce96d0ca10e61a71c4)/linux-1456c984f15e21e28fb8a9ce96d0ca10e61a71c4.tar.gz"
BR2_LINUX_KERNEL_DEFCONFIG="pine64_star64"
BR2_LINUX_KERNEL_CONFIG_FRAGMENT_FILES="$(BR2_EXTERNAL_QOSP_PATH)/board/qosp/star64/linux.fragment"
BR2_LINUX_KERNEL_DTS_SUPPORT=y
BR2_LINUX_KERNEL_INTREE_DTS_NAME="starfive/jh7110-pine64-star64"
BR2_LINUX_KERNEL_INSTALL_TARGET=y
BR2_LINUX_KERNEL_NEEDS_HOST_OPENSSL=y
BR2_PACKAGE_KMOD=y
BR2_PACKAGE_KMOD_TOOLS=y
BR2_PACKAGE_OPENSSH=y
BR2_PACKAGE_IW=y
BR2_PACKAGE_WIRELESS_REGDB=y
BR2_PACKAGE_WPA_SUPPLICANT=y
BR2_PACKAGE_WPA_SUPPLICANT_CLI=y
BR2_PACKAGE_WPA_SUPPLICANT_PASSPHRASE=y
BR2_PACKAGE_ETHTOOL=y
BR2_PACKAGE_IPROUTE2=y
BR2_PACKAGE_PCIUTILS=y
BR2_PACKAGE_USBUTILS=y
BR2_PACKAGE_LIBDRM=y
BR2_PACKAGE_LIBDRM_INSTALL_TESTS=y
BR2_PACKAGE_MESA3D=y
BR2_PACKAGE_MESA3D_GALLIUM_DRIVER_SOFTPIPE=y
BR2_PACKAGE_MESA3D_OPENGL_EGL=y
BR2_PACKAGE_MESA3D_OPENGL_ES=y
BR2_PACKAGE_MESA3D_DEMOS=y
BR2_PACKAGE_QOSP_STAR64_TOOLS=y
BR2_TARGET_ROOTFS_EXT2=y
BR2_TARGET_ROOTFS_EXT2_4=y
BR2_TARGET_ROOTFS_EXT2_SIZE="512M"
# The vendor U-Boot/kernel predate these newer ext4 defaults.
BR2_TARGET_ROOTFS_EXT2_MKFS_OPTIONS="-O ^64bit,^metadata_csum_seed,^orphan_file"
# BR2_TARGET_ROOTFS_TAR is not set
BR2_TARGET_OPENSBI=y
BR2_TARGET_OPENSBI_CUSTOM_VERSION=y
BR2_TARGET_OPENSBI_CUSTOM_VERSION_VALUE="1.6"
BR2_TARGET_OPENSBI_PLAT="generic"
BR2_TARGET_OPENSBI_UBOOT_PAYLOAD=y
BR2_TARGET_UBOOT=y
BR2_TARGET_UBOOT_BUILD_SYSTEM_KCONFIG=y
BR2_TARGET_UBOOT_CUSTOM_TARBALL=y
BR2_TARGET_UBOOT_CUSTOM_TARBALL_LOCATION="$(call github,Fishwaldo,u-boot,172b47f62039605d6806fa96bd403c21cda28996)/u-boot-172b47f62039605d6806fa96bd403c21cda28996.tar.gz"
BR2_TARGET_UBOOT_BOARD_DEFCONFIG="pine64_star64"
BR2_TARGET_UBOOT_CONFIG_FRAGMENT_FILES="$(BR2_EXTERNAL_QOSP_PATH)/board/qosp/star64/uboot.fragment"
BR2_TARGET_UBOOT_NEEDS_OPENSSL=y
BR2_TARGET_UBOOT_SPL=y
BR2_PACKAGE_HOST_GENIMAGE=y
BR2_PACKAGE_HOST_QOSP_STAR64_SPLTOOL=y
BR2_PACKAGE_HOST_UBOOT_TOOLS=y
BR2_PACKAGE_HOST_UBOOT_TOOLS_FIT_SUPPORT=y
```

## tools/buildroot/package/qosp-star64-spltool/Config.in.host
```kconfig
config BR2_PACKAGE_HOST_QOSP_STAR64_SPLTOOL
	bool "host STAR64 vendor SPL header tool"
	depends on BR2_riscv
```

## tools/buildroot/package/qosp-star64-tools/Config.in
```kconfig
config BR2_PACKAGE_QOSP_STAR64_TOOLS
	bool "STAR64 EGL diagnostic"
	depends on BR2_PACKAGE_HAS_LIBEGL
	depends on BR2_PACKAGE_HAS_LIBGLES
```

## tools/buildroot/package/qosp/Config.in
```kconfig
config BR2_PACKAGE_QOSP
	bool "qosp (QOS Portable)"
	depends on BR2_PACKAGE_HAS_LIBEGL
	depends on BR2_PACKAGE_HAS_LIBGLES
	depends on BR2_TOOLCHAIN_HAS_THREADS
	help
	  QOS Portable: the host that runs ONE FP-RISC .qa image over a
	  Linux kernel, with the EGL/GLES gfx tier (qos/Makefile's
	  `portable-es`).  It draws into an offscreen ES 3.1 FBO under
	  surfaceless EGL and puts each frame on the monitor through a
	  KMS dumb buffer, so it needs no X server and no compositor --
	  only a DRM device and Mesa.

	  This package does not download anything.  It builds the qos
	  checkout you point it at, with Buildroot's own cross compiler,
	  by calling that tree's `fpr`.

comment "qosp needs a toolchain w/ threads, and EGL + OpenGL ES"
	depends on !BR2_PACKAGE_HAS_LIBEGL || !BR2_PACKAGE_HAS_LIBGLES || \
		!BR2_TOOLCHAIN_HAS_THREADS

if BR2_PACKAGE_QOSP

config BR2_PACKAGE_QOSP_QOS_DIR
	string "the qos checkout"
	default "$(BR2_EXTERNAL_QOSP_PATH)/../.."
	help
	  The QOS working tree to build.  The default is the one this
	  external tree lives in.

config BR2_PACKAGE_QOSP_FPRISC_DIR
	string "the fprisc checkout"
	default ""
	help
	  The FP-RISC working tree whose `fpr` compiles qosp.  Empty
	  means the sibling ../fprisc of the qos checkout, which is the
	  rule the rest of the build already follows.

	  `fpr` must already be BUILT there: it is a Haskell program and
	  is deliberately not a Buildroot host package.

config BR2_PACKAGE_QOSP_APP
	string "the .qa image to host"
	default ""
	help
	  The application this image exists to run, installed as
	  /usr/share/qosp/app.qa.  Empty means <qos>/app.qa, which is
	  what `make qos-app PROG=...` writes.

config BR2_PACKAGE_QOSP_AUTOSTART
	bool "start it at boot on tty1"
	default y
	help
	  Install an init script that runs the image on tty1 as soon as
	  the system is up -- the appliance the Pi target is for.  The
	  serial console keeps its own getty either way, so there is
	  always a shell to debug from.

config BR2_PACKAGE_QOSP_MAIN_PROFILE
	bool "boot the graphical Main Profile"
	default n
	help
	  Install the paged GUI shell and its seeded onboard application disk.
	  Build the artifacts with tools/main-profile.py on the target architecture
	  first, then set the directory below. Existing persistent disks are kept.

config BR2_PACKAGE_QOSP_MAIN_DIR
	string "Main Profile artifact directory"
	depends on BR2_PACKAGE_QOSP_MAIN_PROFILE
	default ""
	help
	  Directory containing main.qa and Main.disk from tools/main-profile.py.

endif
```
